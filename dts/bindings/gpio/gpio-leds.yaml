## dts/bindings/gpio/gpio-leds.yaml
```yaml
#
# Copyright (c) 2018, Linaro Limited
#
# SPDX-License-Identifier: Apache-2.0
#
---
title: GPIO LED
version: 0.1

description: >
    This is a representation of the LED GPIO nodes

properties:
    compatible:
      type: string
      category: required
      description: compatible strings
      constraint: "gpio-leds"
      generation: define

    gpios:
      type: compound
      category: required
      generation: define

    label:
      type: string
      category: required
      description: Human readable string describing the device (used by Zephyr for API name)
      generation: define


define:
      gpios:
          controller:
             type: 
          pin:
             type: int
             minval: 0
             maxval: 31
          flags:
             type: complex
             elements:
                gpio_direction:
                   type: enum
                   values:
                      - GPIO_DIR_IN
                      - GPIO_DIR_OUT
                gpio_interrupt:
                   type: enum
                   values:
                      - GPIO_INT_ACTIVE_LOW
                      - GPIO_INT_ACTIVE_HIGH
                      - GPIO_INT_DEBOUNCE
                      - GPIO_INT_LEVEL
                      - GPIO_INT_EDGE
                      - GPIO_INT_DOUBLE_EDGE
                gpio_polarity:
                   type: enum
                   values:
                      - GPIO_POL_NORMAL
                      - GPIO_POL_INV
                      - GPIO_POL_MASK
                gpio_pull:
                   type: enum
                   values:
                      - GPIO_PUD_NORMAL
                      - GPIO_PULL_UP
                      - GPIO_PULL_DOWN

...
```
